## main/Kconfig.projbuild
```kconfig
menu "SkyAnchor Cloud / EMQX Config"

config SKY_WIFI_SSID
    string "Wi-Fi SSID"
    default ""
    help
        路由器 SSID。板载 ESP32-C6 作为联网协处理器，P4 通过官方 host 路线接入 Wi‑Fi。

config SKY_WIFI_PASSWORD
    string "Wi-Fi password"
    default ""
    help
        路由器密码；开放网络可留空。

config SKY_WIFI_MAXIMUM_RETRY
    int "Wi-Fi reconnect retry count"
    range 1 255
    default 8
    help
        Wi‑Fi 断开后，station 模式的重连重试计数。

config SKY_MQTT_BROKER_URI
    string "EMQX broker URI"
    default ""
    help
        例如 mqtts://xxxxxxxx.ala.cn-hangzhou.emqxsl.cn:8883

config SKY_MQTT_USERNAME
    string "EMQX username"
    default ""
    help
        在 EMQX Cloud Authentication 里创建的用户名。

config SKY_MQTT_PASSWORD
    string "EMQX password"
    default ""
    help
        在 EMQX Cloud Authentication 里创建的密码。

config SKY_MQTT_CLIENT_ID
    string "MQTT client ID"
    default "skyanchor-p4"
    help
        建议保持唯一，例如 skyanchor-p4。

config SKY_MQTT_DEVICE_NAME
    string "Logical device name"
    default "skyanchor-p4"
    help
        仅用于拼接业务 topic 和状态上报里的 device 字段。

config SKY_MQTT_TOPIC_PREFIX
    string "Business topic prefix"
    default "skyanchor"
    help
        业务 topic 前缀。最终 topic 形如 skyanchor/<device>/cmd|ack|state。

config SKY_MQTT_KEEPALIVE_SEC
    int "MQTT keepalive seconds"
    range 15 300
    default 60
    help
        MQTT Keepalive 时间。

config SKY_MQTT_QOS
    int "MQTT QoS"
    range 0 1
    default 1
    help
        命令、应答与状态上报使用的 QoS。

config SKY_MQTT_USE_CERT_BUNDLE
    bool "Use ESP x509 certificate bundle for TLS verify"
    default y
    help
        推荐开启。使用 IDF 自带的证书包校验 EMQX 服务端证书。

config SKY_MQTT_SKIP_SERVER_CERT_VERIFY
    bool "Skip server cert verification (debug only)"
    default n
    depends on !SKY_MQTT_USE_CERT_BUNDLE
    help
        仅在调试阶段临时使用，不建议正式演示或答辩时开启。

config SKY_WEATHER_API_KEY
    string "Seniverse weather API key"
    default ""
    help
        心知天气 API Key。主屏幕天气固定查询南昌：
        https://api.seniverse.com/v3/weather/now.json?location=nanchang

endmenu
```

## sdkconfig.defaults
```kconfig
# Rebuilt for official esp_brookesia_phone-style camera route on ESP32-P4
CONFIG_ESPTOOLPY_FLASHSIZE_16MB=y
# CONFIG_PARTITION_TABLE_SINGLE_APP_LARGE is not set
CONFIG_PARTITION_TABLE_CUSTOM=y
CONFIG_PARTITION_TABLE_CUSTOM_FILENAME="partitions.csv"
CONFIG_PARTITION_TABLE_FILENAME="partitions.csv"
CONFIG_ESP32P4_SELECTS_REV_LESS_V3=y
CONFIG_COMPILER_OPTIMIZATION_PERF=y
CONFIG_SPIRAM=y
CONFIG_SPIRAM_SPEED_200M=y
CONFIG_SPIRAM_SPEED=200
CONFIG_SPIRAM_XIP_FROM_PSRAM=y
CONFIG_SPIRAM_USE_MALLOC=y
CONFIG_SPIRAM_MALLOC_ALWAYSINTERNAL=16384
CONFIG_SPIRAM_TRY_ALLOCATE_WIFI_LWIP=y
CONFIG_SPIRAM_MALLOC_RESERVE_INTERNAL=65536
CONFIG_MBEDTLS_EXTERNAL_MEM_ALLOC=y
CONFIG_MBEDTLS_DYNAMIC_BUFFER=y
# CONFIG_MBEDTLS_SSL_KEEP_PEER_CERTIFICATE is not set
CONFIG_CACHE_L2_CACHE_LINE_128B=y
CONFIG_BSP_LCD_DPI_BUFFER_NUMS=3
CONFIG_BSP_DISPLAY_LVGL_AVOID_TEAR=y
CONFIG_BSP_DISPLAY_LVGL_FULL_REFRESH=y
CONFIG_BSP_LCD_COLOR_FORMAT_RGB565=y
CONFIG_CAMERA_SC2336=y
CONFIG_CAMERA_SC2336_MIPI_RAW8_1024X600_30FPS=y
CONFIG_CAMERA_SC2336_MIPI_RAW10_1280X720_30FPS=y
CONFIG_CAMERA_SC2336_MIPI_DEFAULT_FMT_RAW8_1024X600_30FPS=y
CONFIG_ESP_VIDEO_ENABLE_ISP=y
CONFIG_ESP_VIDEO_ENABLE_MIPI_CSI_VIDEO_DEVICE=y
CONFIG_ESP_VIDEO_ENABLE_ISP_VIDEO_DEVICE=y
CONFIG_ESP_VIDEO_ENABLE_DVP_VIDEO_DEVICE=n
CONFIG_ESP_VIDEO_ENABLE_ISP_PIPELINE_CONTROLLER=y

# ESP-Hosted: 板载 ESP32-C6 通过 SDIO 通信，切勿改为 SPI/UART
# 必须设置 SLAVE_IDF_TARGET，否则 Kconfig 中 C6 选项的 depends on 不满足
# → C6 选项被隐藏 → 回退到无依赖的 H2 → SDIO 不可用 → 掉到 SPI
CONFIG_ESP_WIFI_REMOTE_ENABLED=y
CONFIG_ESP_WIFI_REMOTE_LIBRARY_HOSTED=y
# CONFIG_ESP_WIFI_REMOTE_LIBRARY_EPPP is not set
# CONFIG_ESP_WIFI_REMOTE_LIBRARY_CUSTOM is not set
CONFIG_ESP_HOSTED_ENABLED=y
# CONFIG_SLAVE_IDF_TARGET_ESP32 is not set
# CONFIG_SLAVE_IDF_TARGET_ESP32S2 is not set
# CONFIG_SLAVE_IDF_TARGET_ESP32C3 is not set
# CONFIG_SLAVE_IDF_TARGET_ESP32S3 is not set
# CONFIG_SLAVE_IDF_TARGET_ESP32C2 is not set
CONFIG_SLAVE_IDF_TARGET_ESP32C6=y
# CONFIG_SLAVE_IDF_TARGET_ESP32C5 is not set
# CONFIG_SLAVE_IDF_TARGET_ESP32C61 is not set
CONFIG_ESP_HOSTED_CP_TARGET_ESP32C6=y
# CONFIG_ESP_HOSTED_CP_TARGET_ESP32H2 is not set
# CONFIG_ESP_HOSTED_CP_TARGET_ESP32H4 is not set
CONFIG_ESP_HOSTED_P4_DEV_BOARD_FUNC_BOARD=y
# CONFIG_ESP_HOSTED_SPI_HOST_INTERFACE is not set
CONFIG_ESP_HOSTED_SDIO_HOST_INTERFACE=y
# CONFIG_ESP_HOSTED_SPI_HD_HOST_INTERFACE is not set
# CONFIG_ESP_HOSTED_UART_HOST_INTERFACE is not set

# P4 + C6 SDIO 缓冲区（降低数值以释放内部 DMA 池给 I2S 音频）
CONFIG_WIFI_RMT_STATIC_RX_BUFFER_NUM=8
CONFIG_WIFI_RMT_DYNAMIC_RX_BUFFER_NUM=16
CONFIG_WIFI_RMT_STATIC_TX_BUFFER=y
CONFIG_WIFI_RMT_TX_BUFFER_TYPE=0
CONFIG_WIFI_RMT_STATIC_TX_BUFFER_NUM=8
CONFIG_WIFI_RMT_CACHE_TX_BUFFER_NUM=16
CONFIG_WIFI_RMT_STATIC_RX_MGMT_BUFFER=y
CONFIG_WIFI_RMT_ESPNOW_MAX_ENCRYPT_NUM=7
CONFIG_WIFI_RMT_AMPDU_TX_ENABLED=y
CONFIG_WIFI_RMT_TX_BA_WIN=32
CONFIG_WIFI_RMT_AMPDU_RX_ENABLED=y
CONFIG_WIFI_RMT_RX_BA_WIN=32

CONFIG_LWIP_TCP_SND_BUF_DEFAULT=65534
CONFIG_LWIP_TCP_WND_DEFAULT=65534
CONFIG_LWIP_TCP_RECVMBOX_SIZE=64
CONFIG_LWIP_UDP_RECVMBOX_SIZE=64
CONFIG_LWIP_TCPIP_RECVMBOX_SIZE=64
CONFIG_LWIP_TCP_SACK_OUT=y
```

## sdkconfig.defaults.esp32p4
```kconfig
# 官方 ESP32-P4-Function-EV-Board + 板载 ESP32-C6 host 路线默认项
# 板载 C6 通过 SDIO 通信，切勿改为 SPI/UART
CONFIG_ESP_WIFI_REMOTE_ENABLED=y
CONFIG_ESP_WIFI_REMOTE_LIBRARY_HOSTED=y
# CONFIG_ESP_WIFI_REMOTE_LIBRARY_EPPP is not set
# CONFIG_ESP_WIFI_REMOTE_LIBRARY_CUSTOM is not set
CONFIG_ESP_HOSTED_ENABLED=y
# CONFIG_SLAVE_IDF_TARGET_ESP32 is not set
# CONFIG_SLAVE_IDF_TARGET_ESP32S2 is not set
# CONFIG_SLAVE_IDF_TARGET_ESP32C3 is not set
# CONFIG_SLAVE_IDF_TARGET_ESP32S3 is not set
# CONFIG_SLAVE_IDF_TARGET_ESP32C2 is not set
CONFIG_SLAVE_IDF_TARGET_ESP32C6=y
# CONFIG_SLAVE_IDF_TARGET_ESP32C5 is not set
# CONFIG_SLAVE_IDF_TARGET_ESP32C61 is not set
CONFIG_ESP_HOSTED_CP_TARGET_ESP32C6=y
# CONFIG_ESP_HOSTED_CP_TARGET_ESP32H2 is not set
# CONFIG_ESP_HOSTED_CP_TARGET_ESP32H4 is not set
CONFIG_ESP_HOSTED_P4_DEV_BOARD_FUNC_BOARD=y
# CONFIG_ESP_HOSTED_SPI_HOST_INTERFACE is not set
CONFIG_ESP_HOSTED_SDIO_HOST_INTERFACE=y
# CONFIG_ESP_HOSTED_SPI_HD_HOST_INTERFACE is not set
# CONFIG_ESP_HOSTED_UART_HOST_INTERFACE is not set

# 官方文档给出的 P4 + C6 推荐缓冲区 / LWIP 参数
CONFIG_WIFI_RMT_STATIC_RX_BUFFER_NUM=16
CONFIG_WIFI_RMT_DYNAMIC_RX_BUFFER_NUM=64
CONFIG_WIFI_RMT_DYNAMIC_TX_BUFFER_NUM=64
CONFIG_WIFI_RMT_TX_BUFFER_TYPE=1
CONFIG_WIFI_RMT_DYNAMIC_RX_MGMT_BUF=0
CONFIG_WIFI_RMT_ESPNOW_MAX_ENCRYPT_NUM=7
CONFIG_WIFI_RMT_AMPDU_TX_ENABLED=y
CONFIG_WIFI_RMT_TX_BA_WIN=32
CONFIG_WIFI_RMT_AMPDU_RX_ENABLED=y
CONFIG_WIFI_RMT_RX_BA_WIN=32

CONFIG_LWIP_TCP_SND_BUF_DEFAULT=65534
CONFIG_LWIP_TCP_WND_DEFAULT=65534
CONFIG_LWIP_TCP_RECVMBOX_SIZE=64
CONFIG_LWIP_UDP_RECVMBOX_SIZE=64
CONFIG_LWIP_TCPIP_RECVMBOX_SIZE=64
CONFIG_LWIP_TCP_SACK_OUT=y
```
